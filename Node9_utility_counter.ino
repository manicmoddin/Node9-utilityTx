#include <EEPROMVar.h>
#include <EEPROMex.h>

//#include <Arduino.h>
//#define NOT_AN_INTERRUPT -1
#include <JeeLib.h>
/*
+-----------------------------------------------------------------------------+
 |                                                                             |
 | Utility Counter:                                                            |
 | A simple application that uses the two interrupts on the arduino to count   |
 | the ppulses generated by the utility meters.                                |
 | In this instance the Gas meter is "Analouge" in the sence that it has a     |
 | rotating, magnetic disc that turns for every 1/1000 of a unit.              |
 | The Electricity meter is digital, and flashes once every 1/1000 of a kWh    |
 |                                                                             |
 | Author: Jimmy Kemp                                        Date : 08/12/2015 |
 | Licence : Released into public Domain                                       |
 |                                                                             |
 +-----------------------------------------------------------------------------+
 */

//define initial variables

int gas_num = 11236;          // The actual reading that the gas company want
int oldGas_num = 0;
int gas_hund = 0;         // The thousandths of a unit

int elect_num = 0;        // The actual reading the elctricity company want
int oldElect_num;
int elect_thou = 0;        // The thousandths of a unit

int gasPin = 3;
int gasState = 1;
int oldGasState =1;
const int maxAllowedWrites = 80;

//Port leds(4);

typedef struct {
  int gasReading, gasReadingHund, electricReading, electricReadingThou;
} 
PayloadU;
PayloadU utility;

//long previousMillis = 0;        // will store last time LED was updated
//long interval = 10000;          // interval at which to blink (milliseconds)

ISR(WDT_vect) { Sleepy::watchdogEvent(); }

void setup() {
  rf12_initialize(9, RF12_433MHZ, 210);
  //get last readings from eeprom
  gas_num = EEPROM.readInt(255);
  Serial.begin(9600);
  Serial.println("Gas Meter Reading \t\tElectric Meter Reading");
  Serial.println();
  pinMode(gasPin, INPUT);
  //turn on pull up resistor
  digitalWrite(gasPin,HIGH);
  //attachInterrupt(digitalPinToInterrupt(gasPin), incrementGas(), FALLING);
  attachInterrupt(1, incrementGas, FALLING);
  //attachInterrupt(1, send_rf_data, RISING);
  //leds.mode(OUTPUT);
  //leds.mode2(OUTPUT);
  //leds.digiWrite(0);
  //leds.digiWrite2(0);
}

void loop() {
  utility.gasReading = gas_num;
  utility.gasReadingHund = gas_hund;
  if(gas_num != oldGas_num) {
    //we need to update the eeprom
    oldGas_num = gas_num;
    EEPROM.updateInt(255, gas_num);
  }

//  unsigned long currentMillis = millis();
  send_rf_data();
  rf12_sleep(RF12_SLEEP);
  Sleepy::loseSomeTime(30000);
  rf12_sleep(RF12_WAKEUP);
}

void incrementGas() {
  if (gas_hund < 99) {
    gas_hund ++;
  }
  else {
    gas_hund = 0;
    gas_num ++;
  }
}

void incrementElect() {
  if (elect_thou < 999) {
    elect_thou ++;
  }
  else {
    elect_thou = 0;
    elect_num ++;
  }
}

void send_rf_data()
{
//  //digitalWrite(activityLed, HIGH);
  //leds.digiWrite(1);
  rf12_sleep(RF12_WAKEUP);
  // if ready to send + exit loop if it gets stuck as it seems too
  int i = 0; 
  while (!rf12_canSend() && i<10) {
    rf12_recvDone(); 
    i++;
  }
  rf12_sendStart(0, &utility, sizeof utility);
  // set the sync mode to 2 if the fuses are still the Arduino default
  // mode 3 (full powerdown) can only be used with 258 CK startup fuses
  rf12_sendWait(2);
  rf12_sleep(RF12_SLEEP);
//  //digitalWrite(activityLed, LOW);
  //leds.digiWrite(0);



}

